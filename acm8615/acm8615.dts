acm8615@34 {
    compatible = "acme,acm8615";
    reg = <0x34>;

    acme,dsp-firmware-dsp_cfg_preboot = <0x00, 0x00, 0x04, 0x00, 0xfc, 0x86, 0xfd, 0x15,
	0xfe, 0x25, 0x00, 0x01, 0x02, 0x20, 0x00, 0x00,
	0x00, 0x00, 0x00, 0x00, 0x00, 0x00, 0x00, 0x00>;
    acme,dsp-firmware-dsp_cfg_default = <0x00, 0x00, 0x04, 0x00, 0x00, 0x00, 0x00, 0x00,
	0x00, 0x00, 0x00, 0x00, 0x00, 0x00, 0x00, 0x05,
	0x70, 0x80, 0x71, 0xbf, 0x72, 0x01, 0x73, 0xbf,
	0x00, 0x04, 0x44, 0x00, 0x45, 0xe2, 0x46, 0xc4,
	0x47, 0x6b, 0x00, 0x01, 0x01, 0x00, 0x00, 0x00,
	0x11, 0x03, 0x02, 0x00, 0x06, 0x30, 0x05, 0xc6,
	0x03, 0x05, 0x01, 0x84, 0x00, 0x00, 0x04, 0x02,
	0x00, 0x00, 0x00, 0x00, 0x00, 0x00, 0x00, 0x00,
	0x00, 0x00, 0x00, 0x00, 0x00, 0x00, 0x00, 0x00,
	0x00, 0x00, 0x04, 0x03>;
};


